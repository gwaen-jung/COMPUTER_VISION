## sdkconfig.defaults
```kconfig
CONFIG_ESPTOOLPY_FLASHSIZE_16MB=y
CONFIG_ESPTOOLPY_FLASHSIZE="16MB"

CONFIG_ESP32S3_SPIRAM_SUPPORT=y
CONFIG_SPIRAM=y
CONFIG_SPIRAM_MODE_OCT=y
CONFIG_SPIRAM_SPEED_80M=y

# Use UART0 for console
CONFIG_ESP_CONSOLE_UART_DEFAULT=y
CONFIG_ESP_CONSOLE_USB_SERIAL_JTAG_SUPPORT=n

# FreeRTOS Hz
CONFIG_FREERTOS_HZ=1000

# Fix UVC Camera descriptor size issue
CONFIG_USB_HOST_CONTROL_TRANSFER_MAX_SIZE=4096
```
